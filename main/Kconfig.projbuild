## main/Kconfig.projbuild
```kconfig
menu "Darvik:ftp-server"
    config FTP_SERVER_PORT
        int "Server port"
        default 2021
        help
            Set FTP Server port

    config FTP_MAX_CONNECTIONS
        int "Max Clients"
        default 4
        help
            Set max FTP clients

    config FTP_RECV_BUF_SIZE
        int "RX buffer size"
        default 4096
        help
            Set RX buffer size
endmenu

menu "ESP HTTP client"


    config ESP_HTTP_CLIENT_ENABLE_HTTPS
        bool "Enable https"
        default y
        help
            This option will enable https protocol by linking esp-tls library and initializing SSL transport

    config ESP_HTTP_CLIENT_ENABLE_BASIC_AUTH
        bool "Enable HTTP Basic Authentication"
        default n
        help
            This option will enable HTTP Basic Authentication. It is disabled by default as Basic
            auth uses unencrypted encoding, so it introduces a vulnerability when not using TLS

    config ESP_HTTP_CLIENT_ENABLE_DIGEST_AUTH
        bool "Enable HTTP Digest Authentication"
        default n
        help
            This option will enable HTTP Digest Authentication. It is enabled by default, but use of this
            configuration is not recommended as the password can be derived from the exchange, so it introduces
            a vulnerability when not using TLS

    config ESP_HTTP_CLIENT_ENABLE_CUSTOM_TRANSPORT
        bool "Enable custom transport"
        default n
        help
            This option will enable injection of a custom tcp_transport handle, so the http operation
            will be performed on top of the user defined transport abstraction (if configured)

endmenu
```
